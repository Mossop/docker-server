## mail/amavisd/init/conf/local.conf
```bitbake
$mydomain = 'example.com';   # a convenient default for other settings
$myhostname = "amavisd.$mydomain";  # must be a fully-qualified domain name!

@local_domains_maps = ( [
  ".$mydomain"
] );  # list of all local domains

@mynetworks = (
  '127.0.0.0/8',
  '[::1]',
  '[FE80::]/10',
  '[FEC0::]/10',
);

@inet_acl = ( '127.0.0.0/8' );

$forward_method = 'smtp:[127.0.0.1]:10025';
$notify_method  = $forward_method;
$localhost_name = $myhostname; # my EHLO name, and inserted in Received

$policy_bank{'MYNETS'} = {   # mail originating from @mynetworks
  originating => 1,  # is true in MYNETS by default, but let's make it explicit
  os_fingerprint_method => undef,  # don't query p0f for internal clients
};

$virus_admin               = "postmaster\@$mydomain";  # notifications recip.
$mailfrom_notify_admin     = "amavisd\@$mydomain";     # notifications sender
$mailfrom_notify_recip     = $mailfrom_notify_admin;   # notifications sender
$mailfrom_notify_spamadmin = $mailfrom_notify_admin;   # notifications sender
$mailfrom_to_quarantine    = $mailfrom_notify_admin;   # notifications sender
```
